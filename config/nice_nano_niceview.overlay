/*
 * Copyright (c) 2020 The ZMK Contributors
 *
 * SPDX-License-Identifier: MIT
 */

&default_transform {
    col-offset = <6>;
    row-offset = <0>;
};

&kscan0 {
    col-gpios
        = <&gpio0 22 GPIO_ACTIVE_HIGH>
        , <&gpio1  0 GPIO_ACTIVE_HIGH>
        , <&gpio0  3 GPIO_ACTIVE_HIGH>
        , <&gpio0  2 GPIO_ACTIVE_HIGH>
        , <&gpio0 28 GPIO_ACTIVE_HIGH>
        , <&gpio0 29 GPIO_ACTIVE_HIGH>
        , <&gpio0 30 GPIO_ACTIVE_HIGH>
        , <&gpio0 31 GPIO_ACTIVE_HIGH>
        , <&gpio0  4 GPIO_ACTIVE_HIGH>
        , <&gpio0  5 GPIO_ACTIVE_HIGH>
        , <&gpio0  6 GPIO_ACTIVE_HIGH>
        , <&gpio0  7 GPIO_ACTIVE_HIGH>
        ;
    row-gpios
        = <&gpio0 19 (GPIO_ACTIVE_HIGH | GPIO_PULL_DOWN)>
        , <&gpio0 20 (GPIO_ACTIVE_HIGH | GPIO_PULL_DOWN)>
        , <&gpio0 21 (GPIO_ACTIVE_HIGH | GPIO_PULL_DOWN)>
        , <&gpio0 23 (GPIO_ACTIVE_HIGH | GPIO_PULL_DOWN)>
        ;
}; 